## sdkconfig.defaults
```kconfig
# ESP-IDF SDK configuration overrides
# Applied during build via board_build.sdkconfig in platformio.ini.
#
# lwIP tuning — reducing network resource exhaustion under concurrent load
# (SMB upload + SleepHQ TLS streaming + web server all sharing the same pbuf pool).
#
# Default CONFIG_LWIP_PBUF_POOL_SIZE is 10. Each pbuf is ~1.6 KB, so 32 pbufs
# costs ~35 KB of additional DRAM but prevents EAGAIN exhaustion when the web
# server holds multiple open connections during an active upload session.

CONFIG_LWIP_PBUF_POOL_SIZE=16

# Increase the TCP/IP thread receive mailbox so bursts of incoming packets
# from concurrent connections are not dropped before lwIP can process them.
# Default is 32; doubling reduces packet loss under rapid browser refresh.
CONFIG_LWIP_TCPIP_RECVMBOX_SIZE=32

# Larger per-socket receive mailboxes reduce the chance that a slow SleepHQ
# TLS write stalls the lwIP receive path for other sockets.
CONFIG_LWIP_TCP_RECVMBOX_SIZE=8
CONFIG_LWIP_UDP_RECVMBOX_SIZE=6

# Reduce WiFi static RX buffers (default 8 → 6, saves ~3KB)
CONFIG_ESP32_WIFI_STATIC_RX_BUFFER_NUM=6

# ── Power management ─────────────────────────────────────────────────────────
# Disable Bluetooth entirely — firmware is WiFi-only.
# Saves ~30 KB DRAM and eliminates BT-related leakage current.
CONFIG_BT_ENABLED=n

# Cap the PHY-level maximum WiFi TX power at 10 dBm (Kconfig minimum).
# Prevents peak current spikes during RF calibration and association even
# before runtime code has a chance to call esp_wifi_set_max_tx_power().
# The Kconfig range is 10-20; 10 is the absolute floor.
CONFIG_ESP_PHY_MAX_WIFI_TX_POWER=10

# Enable ESP-IDF power management framework (required for DFS).
# Allows automatic CPU frequency scaling when tasks are idle.
CONFIG_PM_ENABLE=y

# FreeRTOS tick rate — Arduino ESP32 framework enforces CONFIG_FREERTOS_HZ=1000.
# The check is in framework-arduinoespressif32/CMakeLists.txt line ~405.
# Cannot be overridden in hybrid compile mode.
# CONFIG_FREERTOS_HZ=1000

# ── Core dump to flash ────────────────────────────────────────────────────────
# Save panic backtraces to the coredump partition (64KB at 0x3F0000).
# Read with: espcoredump.py info_corefile -t elf <firmware.elf>
# ELF format gives the richest backtrace info including task stacks.
CONFIG_ESP_COREDUMP_ENABLE_TO_FLASH=y
CONFIG_ESP_COREDUMP_DATA_FORMAT_ELF=y
CONFIG_ESP_COREDUMP_CHECKSUM_CRC32=y

# ── Tickless idle ─────────────────────────────────────────────────────────────
# ENABLED: required for auto light-sleep. The original GPIO wakeup conflict
# with PCNT on CS_SENSE (GPIO 33) is resolved by suspending the PCNT unit
# in IDLE/COOLDOWN states (releasing its PM lock) and using FreeRTOS tickless
# idle for periodic timer-based wakeup instead of GPIO wakeup.
CONFIG_FREERTOS_USE_TICKLESS_IDLE=y
CONFIG_FREERTOS_IDLE_TIME_BEFORE_SLEEP=3

# ── Brownout detector threshold ─────────────────────────────────────────────
# Use the default brownout level 0 (~2.43V). Level 7 (~2.74V) was tested but
# triggered too many resets on power-constrained CPAP hardware. Level 0 gives
# the widest voltage headroom while still protecting against deep rail collapse.
# Users with severe brownout issues can set BROWNOUT_DETECT=OFF in config.txt
# to disable the detector entirely (at their own risk).
CONFIG_ESP32_BROWNOUT_DET_LVL_SEL_0=y

# ── mbedTLS: struct-safe cipher removal ───────────────────────────────────────
# The hybrid compile recompiles IDF libs (incl. mbedTLS) but NOT the Arduino
# framework (WiFiClientSecure). Options that change struct sizes are FORBIDDEN:
#   KEEP_PEER_CERTIFICATE, SESSION_TICKETS, RENEGOTIATION, DTLS options,
#   ASYMMETRIC_CONTENT_LEN, VARIABLE_BUFFER_LENGTH
# However, cipher algorithm removal is SAFE — it only removes code/ciphersuites,
# not struct fields. Removing ChaCha20/Poly1305 forces AES-GCM negotiation
# which uses the ESP32's hardware AES accelerator (faster + lower power).
CONFIG_MBEDTLS_CHACHA20_C=n
CONFIG_MBEDTLS_POLY1305_C=n
CONFIG_MBEDTLS_CHACHAPOLY_C=n

# ── WiFi sleep optimizations ──────────────────────────────────────────────────
# Place WiFi TBTT/beacon processing in IRAM for faster sleep/wake transitions.
# Costs ~1.3KB IRAM but reduces average current during modem-sleep.
CONFIG_ESP_WIFI_SLP_IRAM_OPT=y
# Reduce minimum WiFi active time after wake (default 50ms → 8ms).
# Allows faster return to modem-sleep after processing beacon/data.
CONFIG_ESP_WIFI_SLP_DEFAULT_MIN_ACTIVE_TIME=8
```
